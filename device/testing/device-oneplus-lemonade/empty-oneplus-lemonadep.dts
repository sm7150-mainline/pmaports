/dts-v1/;
/plugin/;

/ {
    model = "Qualcomm Technologies, Inc. Lahaina MTP lemonadep";
    compatible = "qcom,lahaina-mtp", "qcom,lahaina", "qcom,mtp";
    qcom,board-id = <0x10008 0>;
    oem,project-id = <0x19815 0x2085A>;
    oem,project-codename = "lemonadep","lemonadept","lemonadepv";
    oem,hw-id = <12 13 21 22 23 31 32 33>;
};

&apps_rsc {
    compatible = "qcom,rpmh-rsc";
};
