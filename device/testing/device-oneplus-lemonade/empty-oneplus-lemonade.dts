/dts-v1/;
/plugin/;

/ {
    model = "Qualcomm Technologies, Inc. Lahaina MTP lemonade";
    compatible = "qcom,lahaina-mtp", "qcom,lahaina", "qcom,mtp";
    qcom,board-id = <0x10008 0>;
    oem,project-id = <0x19825>;
    oem,project-codename = "lemonade";
    oem,hw-id = <11 12 13 21 22 23 31 32 33>;
};

&apps_rsc {
    compatible = "qcom,rpmh-rsc";
};
